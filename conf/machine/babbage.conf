## conf/machine/babbage.conf
```bitbake
#@TYPE: Machine
#@NAME: Babbage machine
#@DESCRIPTION: Machine configuration for the imx51 babbage oard 
#@Website: http://www.freescale.com/webapp/sps/site/prod_summary.jsp?code=i.MX515

TARGET_ARCH = "arm"

PREFERRED_PROVIDER_virtual/xserver = "xserver-xorg"
XSERVER = "xserver-xorg \
           xf86-input-evdev \
           xf86-input-mouse \
           xf86-video-fbdev \
           xf86-input-keyboard"

# Only has DVI connector for external screen
GUI_MACHINE_CLASS = "bigscreen"

# kernel stuff
PREFERRED_PROVIDER_virtual/kernel = "linux-imx"

IMAGE_FSTYPES += "tar.bz2"

SERIAL_CONSOLE = "115200 ttymxc0"

MACHINE_FEATURES = "kernel26 screen apm usbgadget usbhost vfat alsa"

require conf/machine/include/tune-cortexa8.inc
```

## conf/machine/mx35pdk.conf
```bitbake
#@TYPE: Machine
#@NAME: mx35 development kit machine
#@DESCRIPTION: Machine configuration for the imx35 dev kit board 
#@Website: http://www.freescale.com/webapp/sps/site/overview.jsp?nodeId=0162468rH31143ZrDR633D
TARGET_ARCH = "arm"

PREFERRED_PROVIDER_virtual/xserver = "xserver-xorg"
XSERVER = "xserver-xorg \
           xf86-input-evdev \
           xf86-input-mouse \
           xf86-video-fbdev \
           xf86-input-keyboard"

# Only has DVI connector for external screen
GUI_MACHINE_CLASS = "bigscreen"

# kernel stuff
PREFERRED_PROVIDER_virtual/kernel = "linux-imx"

IMAGE_FSTYPES += "tar.bz2" 

SERIAL_CONSOLE = "115200 ttymxc0"

MACHINE_FEATURES = "kernel26 screen apm usbgadget usbhost vfat alsa"

require conf/machine/include/tune-arm1136jf-s.inc
```
